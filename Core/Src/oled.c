#include "oled.h"
#include <stdio.h>

#define OLED_ADDRESS 0x78U

static I2C_HandleTypeDef *oled_i2c;
static OLED_I2C_ReinitCallback oled_i2c_reinit;

/* 8x6 ASCII 字库，字符范围为 32～126。 */
static const uint8_t ascii_0806[][6] = {
    {0x00,0x00,0x00,0x00,0x00,0x00},
    {0x00,0x00,0x00,0x2f,0x00,0x00},
    {0x00,0x00,0x07,0x00,0x07,0x00},
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    {0x00,0x02,0x01,0x02,0x01,0x00}
};

static void OLED_WriteCmd(uint8_t command);
static void OLED_WriteData(uint8_t data);
static void OLED_SetCursor(uint8_t page, uint8_t column);
static void OLED_ShowChar(uint8_t page, uint8_t column, char character);
static void OLED_ShowNum(uint8_t page, uint8_t column, uint32_t number, uint8_t length);

void OLED_DriverInit(I2C_HandleTypeDef *i2c, OLED_I2C_ReinitCallback reinit_callback)
{
    oled_i2c = i2c;
    oled_i2c_reinit = reinit_callback;
}

static void OLED_WriteCmd(uint8_t command)
{
    uint8_t buffer[2] = {0x00U, command};

    if (HAL_I2C_Master_Transmit(oled_i2c, OLED_ADDRESS, buffer, 2U, 100U) != HAL_OK) {
        oled_i2c_reinit();
        OLED_Init();
        HAL_I2C_Master_Transmit(oled_i2c, OLED_ADDRESS, buffer, 2U, 100U);
    }
}

static void OLED_WriteData(uint8_t data)
{
    uint8_t buffer[2] = {0x40U, data};

    if (HAL_I2C_Master_Transmit(oled_i2c, OLED_ADDRESS, buffer, 2U, 100U) != HAL_OK) {
        oled_i2c_reinit();
        OLED_Init();
        HAL_I2C_Master_Transmit(oled_i2c, OLED_ADDRESS, buffer, 2U, 100U);
    }
}

void OLED_Init(void)
{
    HAL_Delay(100U);
    OLED_WriteCmd(0xAEU);
    OLED_WriteCmd(0xD5U);
    OLED_WriteCmd(0x80U);
    OLED_WriteCmd(0xA8U);
    OLED_WriteCmd(0x3FU);
    OLED_WriteCmd(0xD3U);
    OLED_WriteCmd(0x00U);
    OLED_WriteCmd(0x40U);
    OLED_WriteCmd(0x8DU);
    OLED_WriteCmd(0x14U);
    OLED_WriteCmd(0x20U);
    OLED_WriteCmd(0x00U);
    OLED_WriteCmd(0xA1U);
    OLED_WriteCmd(0xC8U);
    OLED_WriteCmd(0xDAU);
    OLED_WriteCmd(0x12U);
    OLED_WriteCmd(0x81U);
    OLED_WriteCmd(0xCFU);
    OLED_WriteCmd(0xD9U);
    OLED_WriteCmd(0xF1U);
    OLED_WriteCmd(0xDBU);
    OLED_WriteCmd(0x40U);
    OLED_WriteCmd(0xA4U);
    OLED_WriteCmd(0xA6U);
    OLED_WriteCmd(0x2EU);
    OLED_WriteCmd(0xAFU);
    OLED_Clear();
}

void OLED_Clear(void)
{
    uint8_t page;
    uint16_t column;

    for (page = 0U; page < 8U; page++) {
        OLED_WriteCmd((uint8_t)(0xB0U + page));
        OLED_WriteCmd(0x00U);
        OLED_WriteCmd(0x10U);
        for (column = 0U; column < 128U; column++) {
            OLED_WriteData(0x00U);
        }
    }
}

static void OLED_SetCursor(uint8_t page, uint8_t column)
{
    OLED_WriteCmd((uint8_t)(0xB0U + page));
    OLED_WriteCmd((uint8_t)((column & 0x0FU) | 0x00U));
    OLED_WriteCmd((uint8_t)(((column >> 4) & 0x0FU) | 0x10U));
}

static void OLED_ShowChar(uint8_t page, uint8_t column, char character)
{
    uint8_t index;
    uint8_t i;

    if (character < 32 || character > 126) {
        character = '?';
    }
    index = (uint8_t)(character - 32);
    OLED_SetCursor(page, column);
    for (i = 0U; i < 6U; i++) {
        OLED_WriteData(ascii_0806[index][i]);
    }
}

void OLED_ShowString(uint8_t page, uint8_t column, char *text)
{
    while (*text) {
        OLED_ShowChar(page, column, *text);
        text++;
        column = (uint8_t)(column + 6U);
        if (column > 122U) {
            break;
        }
    }
}

static void OLED_ShowNum(uint8_t page, uint8_t column, uint32_t number, uint8_t length)
{
    char buffer[12];

    sprintf(buffer, "%0*lu", length, number);
    OLED_ShowString(page, column, buffer);
}

void OLED_UpdateDisplay(uint16_t value, uint8_t success, uint16_t second)
{
    OLED_ShowString(0U, 0U, "CH0:");
    if (success) {
        OLED_ShowNum(0U, 40U, value, 5U);
        OLED_ShowString(1U, 0U, "Status: OK  ");
    } else {
        OLED_ShowString(0U, 40U, "-----");
        OLED_ShowString(1U, 0U, "Status: FAIL");
    }

    if (second > 0U) {
        OLED_ShowString(2U, 0U, "Time:");
        OLED_ShowNum(2U, 40U, second, 3U);
        OLED_ShowString(2U, 58U, "s");
    } else {
        OLED_ShowString(2U, 0U, "        ");
    }
}
